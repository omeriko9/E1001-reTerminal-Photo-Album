## sdkconfig.defaults
```kconfig
# E1001 reTerminal Default Configuration
# ESP32-S3 specific
CONFIG_IDF_TARGET="esp32s3"
CONFIG_ESPTOOLPY_FLASHSIZE_16MB=y
CONFIG_ESPTOOLPY_FLASHSIZE="16MB"

# Partition table for OTA + large storage
CONFIG_PARTITION_TABLE_CUSTOM=y
CONFIG_PARTITION_TABLE_CUSTOM_FILENAME="partitions.csv"

# Enable PSRAM
CONFIG_ESP32S3_SPIRAM_SUPPORT=y
CONFIG_SPIRAM=y
CONFIG_SPIRAM_MODE_OCT=y
CONFIG_SPIRAM_SPEED_80M=y

# WiFi
CONFIG_ESP_WIFI_STATIC_RX_BUFFER_NUM=10
CONFIG_ESP_WIFI_DYNAMIC_RX_BUFFER_NUM=32
CONFIG_ESP_WIFI_DYNAMIC_TX_BUFFER_NUM=32

# HTTP Server
CONFIG_HTTPD_MAX_REQ_HDR_LEN=1024
CONFIG_HTTPD_MAX_URI_LEN=512

# FatFS for SD Card
CONFIG_FATFS_LFN_HEAP=y
CONFIG_FATFS_MAX_LFN=255
CONFIG_FATFS_API_ENCODING_UTF_8=y

# NVS
CONFIG_NVS_ENCRYPTION=n

# Power Management
CONFIG_PM_ENABLE=y
CONFIG_PM_DFS_INIT_AUTO=y

# Deep Sleep
CONFIG_ESP_SLEEP_GPIO_RESET_WORKAROUND=y
CONFIG_ESP_SLEEP_FLASH_LEAKAGE_WORKAROUND=y

# Logging (reduce in production)
CONFIG_LOG_DEFAULT_LEVEL_INFO=y
CONFIG_LOG_MAXIMUM_LEVEL_DEBUG=y

# SNTP for time sync
CONFIG_LWIP_SNTP_MAX_SERVERS=3

# SPI RAM for framebuffer
CONFIG_SPIRAM_MALLOC_ALWAYSINTERNAL=4096

# Increase max sockets for better concurrency
CONFIG_LWIP_MAX_SOCKETS=16

# Increase Timer Task Stack to prevent overflow
CONFIG_FREERTOS_TIMER_TASK_STACK_DEPTH=4096
CONFIG_SPIRAM_MALLOC_RESERVE_INTERNAL=32768

# Watchdog
CONFIG_ESP_TASK_WDT_TIMEOUT_S=30

# Bootloader
CONFIG_BOOTLOADER_APP_ROLLBACK_ENABLE=y

# System Event Task Stack
CONFIG_ESP_SYSTEM_EVENT_TASK_STACK_SIZE=4096
```
